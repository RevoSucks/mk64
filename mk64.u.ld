/* Mario Kart 64 (U) linker script
 * generated by n64split v0.4a - N64 ROM splitter */

OUTPUT_ARCH (mips)

SECTIONS
{
   /* header and boot */
   .header 0x0 : AT(0x0) {
      build/asm/rom_header.o(.text);
      build/asm/boot.o(.text);
   }

   /* 0x80000400 001000-0D9B70 [D8B70] */
   .text80000400 0x80000400 : AT(0x001000) {
      build/asm/entry.o(.text);
	  build/src/main.o(.text);
      build/asm/code_800004E0.o(.text);
      build/asm/code_800029B0.o(.text);
      build/asm/code_80003550.o(.text);
      build/asm/code_800040C0.o(.text);
      build/asm/code_80004740.o(.text);
      build/asm/code_80004EF0.o(.text);
      build/asm/code_80005FB0.o(.text);
      build/asm/code_80005FD0.o(.text);
      build/asm/code_8001C4D0.o(.text);
      build/asm/code_8001F980.o(.text);
      build/asm/code_80027040.o(.text);
      build/asm/code_80027D00.o(.text);
      build/asm/code_800393C0.o(.text);
      build/asm/code_8003DC40.o(.text);
      build/asm/code_80040030.o(.text);
      build/asm/code_800400D0.o(.text);
      build/asm/code_800405D0.o(.text);
      build/asm/code_80040D00.o(.text);
      build/asm/code_80040E50.o(.text);
      build/asm/code_800431B0.o(.text);
      build/asm/code_80057C60.o(.text);
      build/asm/code_8006E9C0.o(.text);
      build/asm/code_80071F00.o(.text);
      build/asm/code_80086E70.o(.text);
      build/asm/code_8008C1D0.o(.text);
      build/asm/code_80091750.o(.text);
      build/asm/code_800AF9B0.o(.text);
      build/asm/audio/synthesis.o(.text);
      build/asm/audio/heap.o(.text);
      build/asm/audio/load.o(.text);
      build/asm/audio/playback.o(.text);
      build/asm/audio/effects.o(.text);
      build/asm/audio/seqplayer.o(.text);
      build/asm/audio/external.o(.text);
      build/asm/audio/port_eu.o(.text);
      build/asm/libultra.o(.text);
      build/data/rsp.o(.data);
   }

   /* 0x8028DF00 0F7510-121DA0 [2A890] */
   .text8028DF00 0x8028DF00 : AT(0x0F7510) {
      build/asm/code_8028DF00.o(.text);
      build/asm/code_80290C20.o(.text);
      build/asm/code_80296A50.o(.text);
      build/asm/code_802A3730.o(.text);
      build/asm/code_802A7B70.o(.text);
      build/asm/code_802B0210.o(.text);
      build/asm/code_802B4F60.o(.text);
      build/data/data_121DA0.o(.data);
   }

   /* 0x80280000 123640-128480 [4E40] */
   .text80280000 0x80280000 : AT(0x123640) {
      build/asm/code_80280000.o(.text);
      build/asm/code_80280650.o(.text);
      build/asm/code_80281610.o(.text);
      build/asm/code_80281780.o(.text);
      build/asm/code_80281C40.o(.text);
      build/asm/code_80281FA0.o(.text);
      build/data/game_data.o(.assets);
      build/data/sound_data.o(.assets);
   }

   /* Discard everything not specifically mentioned above. */
   /DISCARD/ :
   {
      *(*);
   }
}